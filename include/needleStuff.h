// needleStuff.h — Needle drawing over a pre-rendered raw RGB565 background.
//
// Background restore strategy:
//   initNeedleCache(cx, cy)  — call AFTER LittleFS.begin()
//                              Opens dialBg.raw (pre-generated by tools/gen_dialBg_raw.py).
//                              Keeps the file open for fast row-seek restores.
//
//   drawNeedle(cx, cy, angleDeg) — erases previous needle by seeking into
//                                  dialBg.raw row-by-row, then draws the new needle.
//
// RAM used: CACHE_W × 2 bytes line buffer (534 bytes) — no large heap allocation.
// Generate dialBg.raw:  python3 tools/gen_dialBg_raw.py  (run from project root)

#pragma once

#include <Arduino.h>
#include <TFT_eSPI.h>
#include <FS.h>
#include <LittleFS.h>
#include <math.h>

extern TFT_eSPI tft;

// ============================================================================
// CONFIG  —  must match tools/gen_dialBg_raw.py
// ============================================================================

static const int      NEEDLE_L    = 140;          // needle length in pixels
static const int      BASE_W      = 11;           // base width at pivot
static const int      HUB_R       = 9;            // pivot hub radius
static const int      SHAFT_R     = 2;            // centre dot radius
static const uint16_t COL_NEEDLE  = TFT_RED;
static const uint16_t NEEDLE_SHAFT= TFT_DARKGREY;

static const char    *BG_RAW      = "/dialBg.raw";
static const int16_t  CACHE_R     = 143;          // NEEDLE_L + 3
static const int16_t  CACHE_W     = 2 * CACHE_R + 1;  // 287

// ============================================================================
// STATE
// ============================================================================

static File     g_bgFile;
static int16_t  g_nCX        = 240;
static int16_t  g_nCY        = 160;
static bool     g_bgReady    = false;

static uint16_t g_lineBuf[CACHE_W];   // 534 bytes — reused every restore row

// Previous needle bounding box (for restore on next draw)
static int  prevBX = 0, prevBY = 0, prevBW = 0, prevBH = 0;
static bool havePrev = false;

// Call whenever the screen is fully redrawn so drawNeedle() skips the stale restore.
static inline void needleInvalidate() { havePrev = false; }

// ============================================================================
// INIT  —  call AFTER LittleFS.begin()
// ============================================================================

static inline bool initNeedleCache(int16_t cx, int16_t cy)
{
    g_nCX = cx;
    g_nCY = cy;

    g_bgFile = LittleFS.open(BG_RAW, "r");
    if (!g_bgFile) {
        Serial.printf("[NEEDLE] dialBg.raw not found — run tools/gen_dialBg_raw.py\n");
        g_bgReady = false;
        return false;
    }

    const uint32_t expected = (uint32_t)CACHE_W * CACHE_W * 2;
    if (g_bgFile.size() != expected) {
        Serial.printf("[NEEDLE] dialBg.raw wrong size: %u (expected %u)\n",
                      g_bgFile.size(), expected);
        g_bgFile.close();
        g_bgReady = false;
        return false;
    }

    g_bgReady = true;
    Serial.printf("[NEEDLE] dialBg.raw OK (%dx%d, %u bytes)\n",
                  CACHE_W, CACHE_W, expected);
    return true;
}

// ============================================================================
// NEEDLE DRAW
// ============================================================================

static inline void drawNeedle(int cx, int cy, int angleDeg)
{
    // ── 1) Restore previous needle area from dialBg.raw ──────────────────────
    if (havePrev && g_bgReady) {
        const int cacheLeft = g_nCX - CACHE_R;
        const int cacheTop  = g_nCY - CACHE_R;
        tft.setSwapBytes(false);
        for (int r = 0; r < prevBH; r++) {
            int sy = prevBY + r;
            int cr = sy - cacheTop;
            int cc = prevBX - cacheLeft;
            if (cr < 0 || cr >= CACHE_W || cc < 0 || cc + prevBW > CACHE_W) continue;
            uint32_t offset = ((uint32_t)cr * CACHE_W + cc) * 2;
            g_bgFile.seek(offset);
            g_bgFile.read((uint8_t*)g_lineBuf, prevBW * 2);
            tft.pushImage(prevBX, sy, prevBW, 1, g_lineBuf);
        }
    }

    // ── 2) Geometry ──────────────────────────────────────────────────────────
    const float a     = (float)angleDeg * (float)M_PI / 180.0f;
    const float ux    =  sinf(a);
    const float uy    = -cosf(a);
    const float px    = -uy;
    const float py    =  ux;
    const float halfW = BASE_W * 0.5f;

    const int tipX  = cx + (int)lroundf(ux * NEEDLE_L);
    const int tipY  = cy + (int)lroundf(uy * NEEDLE_L);
    const int inBLx = cx + (int)lroundf(px * (-halfW));
    const int inBLy = cy + (int)lroundf(py * (-halfW));
    const int inBRx = cx + (int)lroundf(px * ( halfW));
    const int inBRy = cy + (int)lroundf(py * ( halfW));

    // ── 3) Needle body + hub + shaft ─────────────────────────────────────────
    tft.fillTriangle(inBLx, inBLy, inBRx, inBRy, tipX, tipY, COL_NEEDLE);
    tft.fillCircle(cx, cy, HUB_R,   COL_NEEDLE);
    tft.fillCircle(cx, cy, SHAFT_R, NEEDLE_SHAFT);

    // ── 4) Bounding box for next restore ─────────────────────────────────────
    int xs[3] = { tipX, inBLx, inBRx };
    int ys[3] = { tipY, inBLy, inBRy };
    int minX = xs[0], maxX = xs[0], minY = ys[0], maxY = ys[0];
    for (int i = 1; i < 3; i++) {
        if (xs[i] < minX) minX = xs[i];
        if (xs[i] > maxX) maxX = xs[i];
        if (ys[i] < minY) minY = ys[i];
        if (ys[i] > maxY) maxY = ys[i];
    }
    if (cx - HUB_R < minX) minX = cx - HUB_R;
    if (cx + HUB_R > maxX) maxX = cx + HUB_R;
    if (cy - HUB_R < minY) minY = cy - HUB_R;
    if (cy + HUB_R > maxY) maxY = cy + HUB_R;

    prevBX   = minX;
    prevBY   = minY;
    prevBW   = (maxX - minX) + 1;
    prevBH   = (maxY - minY) + 1;
    havePrev = true;
}
